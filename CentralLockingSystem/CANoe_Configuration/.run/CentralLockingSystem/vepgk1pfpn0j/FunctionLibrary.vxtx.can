/* !Encoding: 65001  */
includes
{
  #include "__VariablesLib.cin"
  #include "__CaplGeneratorLib.cin"
  #include "__CANoeReportFuntionsLib.cin"
}

variables
{
  // Global variables defined within this CAPL file
}

export void LockManually()
{
  TestCommandBegin(__eSet, __cSet, "", "0");
  {
    __ReportTableHead3Columns(__cSetCaption , __cTSym, __cTOp, __cAssigned); 
    {
      $`CAN::dbNode::`SUT_Driver::`LockingRemoteControlRequest::`LockRequest.phys = 1;
      snprintf(__cArray, 8192, "%s", "LockRequest");
      snprintf(__cArray2, 8192, "%s '%s'", __cCANSignal, __cArray);
      snprintf(__cArray3, 8192, "%s", "Request_lock");
      
      __ReportSetLValueOrSignalNotOnline(`CAN::dbNode::`SUT_Driver::`LockingRemoteControlRequest::`LockRequest, __cArray2, __cArray4);
      __ReportTableRow(0, __cArray4, __cAOp, 1, __cArray3);
      
  
    }
    __ReportTableEndTestStep("1");
  }
  TestCommandEnd();


  TestCommandBegin(__eWait, __cWait, "", "1");
  {
    __Wait("1", (syspar::`LockingTests::`LockRequestWaitTime * 1000000LL), 1000000, "LockRequestWaitTime");
  }
  TestCommandEnd();

}

export void UnlockManually()
{
  TestCommandBegin(__eSet, __cSet, "", "0");
  {
    __ReportTableHead3Columns(__cSetCaption , __cTSym, __cTOp, __cAssigned); 
    {
      $`CAN::dbNode::`SUT_Driver::`LockingRemoteControlRequest::`LockRequest.phys = 2;
      snprintf(__cArray, 8192, "%s", "LockRequest");
      snprintf(__cArray2, 8192, "%s '%s'", __cCANSignal, __cArray);
      snprintf(__cArray3, 8192, "%s", "Request_unlock");
      
      __ReportSetLValueOrSignalNotOnline(`CAN::dbNode::`SUT_Driver::`LockingRemoteControlRequest::`LockRequest, __cArray2, __cArray4);
      __ReportTableRow(0, __cArray4, __cAOp, 2, __cArray3);
      
  
    }
    __ReportTableEndTestStep("1");
  }
  TestCommandEnd();


  TestCommandBegin(__eWait, __cWait, "", "1");
  {
    __Wait("1", (syspar::`LockingTests::`LockRequestWaitTime * 1000000LL), 1000000, "LockRequestWaitTime");
  }
  TestCommandEnd();

}

export void SpeedUpToLockVelocity(int64 offset)
{
int64 __tt60targetVelocity_0;

  {
    __tt60targetVelocity_0 = syspar::`LockingTests::`LockVelocity;
    snprintf(__cArray, elCount(__cArray), "%I64d", __tt60targetVelocity_0);
  }


  TestCommandBegin(__eSet, __cSet, "", "0");
  {
    __type_of((__tt60targetVelocity_0 + offset)) __caplExprVar0;
  
    __ReportTableHead3Columns(__cSetCaption , __cTSym, __cTOp, __cAssigned); 
    {
      __caplExprVar0 = (__tt60targetVelocity_0 + offset);
  
      __tt60targetVelocity_0 = __caplExprVar0;
      snprintf(__cArray, 8192, "%s", "targetVelocity");
      snprintf(__cArray2, 8192, "%s '%s'", __cVariable, __cArray);
      snprintf(__cArray3, 8192, "%s", "targetVelocity + offset");
      
      __ReportTableRow(0, __cArray2, __cAOp, __caplExprVar0, __cArray3);
      
  
    }
    {
      $`CAN::dbNode::`SUT_Driver::`VehicleMotion::`Velocity.phys = __tt60targetVelocity_0;
      snprintf(__cArray, 8192, "%s", "Velocity");
      snprintf(__cArray2, 8192, "%s '%s'", __cCANSignal, __cArray);
      snprintf(__cArray3, 8192, "%s", "targetVelocity");
      
      __ReportSetLValueOrSignalNotOnline(`CAN::dbNode::`SUT_Driver::`VehicleMotion::`Velocity, __cArray2, __cArray4);
      __ReportTableRow(0, __cArray4, __cAOp, __tt60targetVelocity_0, __cArray3);
      
  
    }
    __ReportTableEndTestStep("1");
  }
  TestCommandEnd();


  TestCommandBegin(__eWait, __cWait, "", "1");
  {
    __Wait("1", (500 * 1000000LL), 1000000, "");
  }
  TestCommandEnd();

}

